## conf/layer.conf
```bitbake
# We have a conf and classes directory, add to BBPATH
BBPATH .= ":${LAYERDIR}"

# We have recipes-* directories, add to BBFILES
BBFILES += "${LAYERDIR}/recipes-*/*/*.bb \
	    ${LAYERDIR}/recipes-*/*/*.bbappend"

BBFILE_COLLECTIONS += "tci"
BBFILE_PATTERN_tci := "^${LAYERDIR}/"
BBFILE_PRIORITY_tci = "10"

LAYERDEPENDS_tci = "rockchip"

# This should only be incremented on significant changes that will
# cause compatibility issues with other layers
LAYERVERSION_tci = "1"
LAYERSERIES_COMPAT_tci = "zeus dunfell gatesgarth hardknott"
```

## conf/machine/rockchip-rk3288-tci.conf
```bitbake
# Copyright (c) 2021, for TCI GmbH
# Released under the MIT license (see COPYING.MIT for the terms)

#@TYPE: Machine
#@NAME: RK3288 TCI

require conf/machine/include/rk3288.inc

PREFERRED_VERSION_linux-tci = "4.4%"
PREFERRED_PROVIDER_virtual/kernel = "linux-tci"

#KBUILD_DEFCONFIG = "rockchip_linux_defconfig"
KBUILD_DEFCONFIG = "rk3288_linux_4n_defconfig"

#KERNEL_DEVICETREE = "rk3288-evb-rk808-linux.dtb"
KERNEL_DEVICETREE = "rk3288-evb-rk808-linux-4n-tci.dtb"

UBOOT_MACHINE = "rk3288_defconfig"

RK_TEE_ADDR = "0x08400000"

RK_WIFIBT_FIRMWARES = " \
	rkwifibt-firmware \
	brcm-tools \
"

MACHINE_ESSENTIAL_EXTRA_RRECOMMENDS:append = " kernel-modules"
```
